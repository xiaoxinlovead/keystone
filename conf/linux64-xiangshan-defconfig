## conf/linux64-xiangshan-defconfig
```kconfig
CONFIG_DEFAULT_HOSTNAME="(lvna)"
CONFIG_POSIX_MQUEUE=y
# CONFIG_CROSS_MEMORY_ATTACH is not set
CONFIG_BPF_SYSCALL=y
CONFIG_IKCONFIG=y
CONFIG_IKCONFIG_PROC=y
CONFIG_LOG_BUF_SHIFT=15
CONFIG_CGROUPS=y
CONFIG_CGROUP_SCHED=y
CONFIG_CGROUP_BPF=y
CONFIG_NAMESPACES=y
CONFIG_USER_NS=y
CONFIG_BLK_DEV_INITRD=y
CONFIG_EXPERT=y
CONFIG_NONPORTABLE=y
CONFIG_SMP=y
CONFIG_RISCV_SBI_V01=y
CONFIG_CMDLINE="earlycon=sbi console=hvc0"
CONFIG_CMDLINE_FORCE=y
CONFIG_LSM="yama,safesetid,integrity,bpf"
# CONFIG_STRICT_MODULE_RWX is not set
CONFIG_MODULES=y
CONFIG_MODULE_UNLOAD=y
CONFIG_BINFMT_MISC=y
CONFIG_NET=y
CONFIG_PACKET=y
CONFIG_UNIX=y
CONFIG_INET=y
CONFIG_DEVTMPFS=y
CONFIG_DEVTMPFS_MOUNT=y
# CONFIG_STANDALONE is not set
# CONFIG_PREVENT_FIRMWARE_BUILD is not set
# CONFIG_FW_LOADER is not set
# CONFIG_ALLOW_DEV_COREDUMP is not set
CONFIG_BLK_DEV_LOOP=y
# CONFIG_INPUT_KEYBOARD is not set
# CONFIG_INPUT_MOUSE is not set
CONFIG_SERIO_LIBPS2=y
# CONFIG_VT_CONSOLE is not set
# CONFIG_UNIX98_PTYS is not set
# CONFIG_LEGACY_PTYS is not set
CONFIG_SERIAL_8250=y
CONFIG_SERIAL_8250_CONSOLE=y
CONFIG_SERIAL_8250_DW=y
CONFIG_SERIAL_OF_PLATFORM=y
CONFIG_SERIAL_EARLYCON_RISCV_SBI=y
CONFIG_SERIAL_UARTLITE=y
CONFIG_SERIAL_UARTLITE_CONSOLE=y
CONFIG_HVC_RISCV_SBI=y
CONFIG_HW_RANDOM=y
CONFIG_HW_RANDOM_TIMERIOMEM=y
# CONFIG_HWMON is not set
# CONFIG_USB_SUPPORT is not set
# CONFIG_VIRTIO_MENU is not set
CONFIG_PROC_CHILDREN=y
CONFIG_TMPFS=y
# CONFIG_EFI is not set
CONFIG_PRINTK_TIME=y
CONFIG_RCU_CPU_STALL_TIMEOUT=300
# CONFIG_RCU_TRACE is not set
# CONFIG_FTRACE is not set
# CONFIG_RUNTIME_TESTING_MENU is not set
# CONFIG_RISCV_ISA_ZICBOZ is not set
# CONFIG_RISCV_ISA_ZICBOM is not set
# CONFIG_RISCV_ISA_ZBA is not set
# CONFIG_RISCV_ISA_ZBB is not set
# CONFIG_RISCV_ISA_ZBC is not set
CONFIG_RISCV_ISA_V_DEFAULT_ENABLE=y
CONFIG_KEYSTONE=y
# CONFIG_EFI is not set
# CONFIG_EFI_STUB is not set
CONFIG_INITRAMFS_ROOT_UID=0
CONFIG_INITRAMFS_ROOT_GID=0
```

## sm/plat/nemu_xiangshan/Kconfig
```kconfig
# SPDX-License-Identifier: BSD-2-Clause

config PLATFORM_NEMU_XIANGSHAN
	bool
	select FDT
	select FDT_DOMAIN
	select FDT_PMU
	default y

if PLATFORM_NEMU_XIANGSHAN

config PLATFORM_NEMU_XIANGSHAN_NAME
	string "Platform default name"
	default "NEMU-Xiangshan"

config PLATFORM_NEMU_XIANGSHAN_MAJOR_VER
	int "Platform major version"
	range 0 65535
	default 0

config PLATFORM_NEMU_XIANGSHAN_MINOR_VER
	int "Platform minor version"
	range 0 65535
	default 1

config PLATFORM_NEMU_XIANGSHAN_FDT_EMPTY_SPACE
	int "Platform FDT empty space (KB)"
	range 0 1024
	default 4

endif
```

## sm/plat/nemu_xiangshan/configs/defconfig
```kconfig
CONFIG_FDT=y
CONFIG_FDT_SERIAL=y
CONFIG_FDT_SERIAL_UART8250=y
CONFIG_SERIAL_SEMIHOSTING=y
CONFIG_FDT_IRQCHIP=y
CONFIG_FDT_IRQCHIP_APLIC=y
CONFIG_FDT_IRQCHIP_IMSIC=y
CONFIG_FDT_IPI=y
CONFIG_FDT_IPI_MSWI=y
CONFIG_FDT_TIMER=y
CONFIG_FDT_TIMER_MTIMER=y
CONFIG_FDT_RESET=y
CONFIG_FDT_RESET_HTIF=y

# CONFIG_SBI_ECALL_VENDOR is not set
```
